## conf/layer.conf
```bitbake
# We have a conf and classes directory, add to BBPATH
BBPATH .= ":${LAYERDIR}"

# We have recipes-* directories, add to BBFILES
BBFILES += "${LAYERDIR}/recipes-*/*/*.bb \
            ${LAYERDIR}/recipes-*/*/*.bbappend"

BBFILE_COLLECTIONS += "meta-g8row-ti"
BBFILE_PATTERN_meta-g8row-ti = "^${LAYERDIR}/"
BBFILE_PRIORITY_meta-g8row-ti = "6"

LAYERDEPENDS_meta-g8row-ti = "core"
LAYERSERIES_COMPAT_meta-g8row-ti = "kirkstone"
```
